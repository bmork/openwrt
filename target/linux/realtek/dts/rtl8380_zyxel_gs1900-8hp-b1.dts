// SPDX-License-Identifier: GPL-2.0-or-later

#include "rtl8380_zyxel_gs1900.dtsi"
#include "rtl8380_zyxel_gs1900_gpio.dtsi"

/ {
	compatible = "zyxel,gs1900-8hp-b1", "realtek,rtl838x-soc";
	model = "Zyxel GS1900-8HP B1 Switch";
};

&gpio1 {
	poe_enable {
		gpio-hog;
		gpios = <13 GPIO_ACTIVE_HIGH>;
		output-high;
	};
};

&uart1 {
	status = "okay";
};
